#include "GameSprites.h"
#include "LCD.h"
#include <stdint.h>

#define DUCK_SCALE 3
#define SNIPER_W 75
#define SNIPER_H 61

static const uint8_t SniperSprite[1][4575] = { {
    255, 255, 255, 255, 255, 255, 255, 255, 255, 255, 255, 255,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 255, 
255, 255, 255, 255, 255, 255, 255, 255, 255, 255, 255, 255,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 255, 
255, 255, 255, 255, 255, 255, 255, 255, 255, 255, 255, 255,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 255, 
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255, 255, 255, 255, 255, 255, 255, 255, 255, 255, 255, 255,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 255
}};

static const uint8_t DuckRight1[8][8] = {
    {255,255,255,255,255,255,255,255},
    {255,255,255,255,0,255,255,255},
    {255,255,255,0,15,255,255,255},
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    {255,4,255,255,255,255,255,255}
};

static const uint8_t DuckRight2[8][8] = {
    {255,255,255,255,255,255,255,255},
    {255,255,255,255,255,255,255,255},
    {255,255,255,255,255,255,255,255},
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    {255,4,255,255,0,255,255,255}
};

static const uint8_t CrosshairSprite[9][9] = {
    {255,255,255,255,0,255,255,255,255},
    {255,255,255,255,0,255,255,255,255},
    {255,255,255,255,0,255,255,255,255},
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    {255,255,255,255,0,255,255,255,255}
};

static const uint8_t HitMarkerSprite[9][9] = {
    {0,255,255,255,255,255,255,255,0},
    {255,0,255,255,255,255,255,0,255},
    {255,255,0,255,255,255,0,255,255},
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    {0,255,255,255,255,255,255,255,0}
};

static void Safe_Set_Pixel(int16_t x, int16_t y, uint8_t colour)
{
    if (x < 0 || x >= 240 || y < 0 || y >= 240) {
        return;
    }

    LCD_Set_Pixel((uint16_t)x, (uint16_t)y, colour);
}

void Duck_Draw(int16_t x, int16_t y, int8_t facing_right, uint8_t frame)
{
    const uint8_t (*sprite)[8];

    frame = frame % 2;

    if (frame == 0) {
        sprite = DuckRight1;
    } else {
        sprite = DuckRight2;
    }

    for (int row = 0; row < 8; row++) {
        for (int col = 0; col < 8; col++) {

            int source_col;

            if (facing_right) {
                source_col = col;
            } else {
                source_col = 7 - col;   // mirror horizontally
            }

            uint8_t p = sprite[row][source_col];

            if (p == 255) {
                continue;
            }

            for (int dy = 0; dy < DUCK_SCALE; dy++) {
                for (int dx = 0; dx < DUCK_SCALE; dx++) {
                    int16_t px = x + col * DUCK_SCALE + dx;
                    int16_t py = y + row * DUCK_SCALE + dy;

                    Safe_Set_Pixel(px, py, p);
                }
            }
        }
    }
}

void Crosshair_Draw(int16_t x, int16_t y, uint8_t empty_ammo)
{
    uint8_t colour = empty_ammo ? 11 : 15;

    LCD_Draw_Sprite_Colour_Scaled((uint16_t)(x - 9),
    (uint16_t)(y - 9),
    9,9,(uint8_t*)CrosshairSprite,
    colour,2);
}

void Sniper_Draw(int16_t x, int16_t y)
{
    for (int row = 0; row < SNIPER_H; row++) {
        for (int col = 0; col < SNIPER_W; col++) {
            uint8_t p = SniperSprite[0][row * SNIPER_W + col];

            if (p == 255) {
                continue;   // transparent
            }

            Safe_Set_Pixel(x + col, y + row, p);
        }
    }
}

void HitMarker_Draw(int16_t x, int16_t y)
{
        LCD_Draw_Sprite_Colour_Scaled((uint16_t)(x - 9),
                                  (uint16_t)(y - 9),
                                  9,
                                  9,
                                  (uint8_t*)HitMarkerSprite,
                                  15,
                                  2);
}